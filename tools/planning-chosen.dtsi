/* Planning-build-only overlay, applied by tools/partition_layout.py
 * alongside a board's layout glue when planning (never in real builds).
 *
 * Some upstream board dts point /chosen/zephyr,code-partition at a partition
 * label the fork's layout deletes (e.g. nrf54h20dk's cpuapp_slot0_partition).
 * Real builds don't notice: dts/sysbuild.cmake applies dts/app-partition.overlay
 * with the layout, re-pointing the property at the fork's slot0 for the
 * application image, and dts/boot-partition.overlay re-points it at
 * boot_partition for the bootloader (after the layout). The planning build
 * (hello_world) wants neither -- plan_partitions() and
 * plan_code_partition_split() derive everything from the flash devices, not
 * from chosen -- so delete the property here instead; it comes last, after
 * the board's glue.
 */
/ {
	chosen {
		/delete-property/ zephyr,code-partition;
	};
};