## boot/zephyr/Kconfig.uf2
```kconfig
# Copyright (c) 2026 Scott Shawcroft for Adafruit Industries
#
# SPDX-License-Identifier: Apache-2.0

menuconfig MCUBOOT_UF2
	bool "MCUboot UF2 drag-and-drop update"
	default y if $(dt_nodelabel_enabled,zephyr_udc0)
	select USB_DEVICE_STACK_NEXT
	select USBD_MSC_CLASS
	select DISK_ACCESS
	select REBOOT
	# The USB device controller drivers require kernel threads (e.g.
	# UDC_DWC2 selects EVENTS, which depends on MULTITHREADING), but
	# MCUboot defaults MULTITHREADING off on Nordic/ESP32 SoCs to save
	# code size; only the legacy USB paths (BOOT_SERIAL_CDC_ACM,
	# BOOT_USB_DFU_GPIO/WAIT) re-enable it. Mirror that here for the
	# UF2 (device-next stack) path.
	select MULTITHREADING
	depends on !BOOT_FIRMWARE_LOADER
	help
	  If y, enables UF2 drag-and-drop firmware update mode.
	  MCUboot presents a USB Mass Storage device; users drag
	  a .uf2 file onto it to update firmware.

	  If serial recovery (CONFIG_MCUBOOT_SERIAL) is enabled as well, the
	  bootloader runs a single combined update mode: entering the
	  bootloader (by any enabled entrance method) activates both the
	  UF2 mass storage drive and SMP over the serial recovery port at the
	  same time, on one USB device. When the serial recovery port is CDC
	  ACM, both share the UF2 USB identity (VID/PID and descriptors).

	  Defaults on for boards whose devicetree has a native USB device
	  controller (zephyr_udc0) and off otherwise, so applications don't
	  have to force this per board: boards without USB fall back to UART
	  serial recovery (see MCUBOOT_SERIAL). Explicit assignments in a conf
	  fragment still win.

if MCUBOOT_UF2

config MCUBOOT_UF2_FAMILY_ID
	hex "UF2 family ID"
	default 0x0
	help
	  UF2 family ID to accept. Set to 0 to accept any family.
	  UF2 blocks with a non-matching family ID will be silently
	  ignored. This is shared across an entire product line /
	  implementation.

config MCUBOOT_UF2_BOARD_ID
	string "UF2 board identity"
	default ""
	help
	  Per-board identity string to accept, of the form
	  "<vendor>_<board>" (e.g. "adafruit_feather_nrf52840").
	  Leave empty to accept any board.

	  When non-empty, each UF2 block must carry a matching board identity
	  in a UF2 extension tag (flag 0x00008000) right after its payload;
	  blocks with a non-matching (or absent) board identity are silently
	  ignored. Use a distinct value per board variant. Embed it in images
	  with `tools/uf2conv.py --ext 0x4D7C3A:adafruit_myboard ...`.

	  Note: this is a safeguard against accidental cross-board flashes, not
	  a security boundary. The board identity is not cryptographically
	  protected unless images are signed.

config MCUBOOT_UF2_USB_VID
	hex "USB Vendor ID for UF2 drive"
	default 0x239A
	help
	  USB vendor ID presented by the UF2 bootloader.

config MCUBOOT_UF2_USB_PID
	hex "USB Product ID for UF2 drive"
	default 0x002F
	help
	  USB product ID presented by the UF2 bootloader.

config MCUBOOT_UF2_BOARD_NAME
	string "Board name shown in INFO_UF2.TXT"
	default BOARD
	help
	  Board name reported in the INFO_UF2.TXT virtual file
	  on the UF2 mass storage device.

config MCUBOOT_UF2_BOARD_URL
	string "Board URL for INDEX.HTM redirect"
	default "https://mcuboot.com"
	help
	  URL that INDEX.HTM on the UF2 drive redirects to.

config MCUBOOT_UF2_DISK_NAME
	string "Disk name for USB Mass Storage"
	default "UF2"
	help
	  Disk name registered with the disk_access subsystem.
	  Must match CONFIG_MASS_STORAGE_DISK_NAME.

config MCUBOOT_UF2_MAX_BLOCKS
	int "Maximum number of UF2 blocks"
	default 4096
	help
	  Maximum number of UF2 blocks in a firmware image.
	  Each block carries 256 bytes, so 4096 blocks = 1 MB.
	  The block tracking bitmap uses MAX_BLOCKS/8 bytes of RAM.

menu "Writable partitions"

config MCUBOOT_UF2_WRITABLE_STORAGE
	bool "Allow UF2 writes to the storage (filesystem) partition"
	default y
	help
	  If y, UF2 blocks whose target address falls inside the fixed
	  partition labeled "storage_partition" (e.g. a LittleFS or FAT
	  filesystem) are erased and written there, alongside the primary
	  application slot. This lets a filesystem image be deployed (or the
	  filesystem wiped) by drag-and-drop; blocks targeting the
	  application slot keep updating firmware as usual. The partition is
	  erased progressively as its blocks arrive, so unwritten partitions
	  are untouched. Requires a fixed-partition labeled
	  "storage_partition" in the devicetree; otherwise a warning is
	  logged and the feature is inactive.

config MCUBOOT_UF2_WRITABLE_BOOTLOADER
	bool "Allow UF2 writes to the MCUboot partition (dangerous)"
	default n
	help
	  If y, UF2 blocks targeting the MCUboot partition (fixed partition
	  labeled "mcuboot") are written there. MCUboot is actively executing
	  while UF2 mode is active, so this is only safe on SoCs that can
	  write flash while executing from it. It makes CURRENT.UF2 readbacks
	  (which include the bootloader) fully restorable by drag-and-drop.

endmenu

config MCUBOOT_UF2_VALIDATE_AFTER_WRITE
	bool "Validate image header after UF2 write completes"
	default y
	help
	  After all UF2 blocks are received, validate the MCUboot
	  image header in the target slot before rebooting.

menu "Entrance methods"

config MCUBOOT_UF2_ENTRANCE_GPIO
	bool "Enter UF2 mode via GPIO"
	default y
	depends on GPIO
	help
	  Use the same GPIO detection as serial recovery
	  (io_detect_pin()) to enter UF2 mode instead.

config MCUBOOT_UF2_ENTRANCE_BOOT_MODE
	bool "Enter UF2 mode via boot mode retention"
	depends on RETENTION_BOOT_MODE
	help
	  Enter UF2 mode when the boot mode retention subsystem
	  indicates the application requested it.

config MCUBOOT_UF2_ENTRANCE_DOUBLE_TAP
	bool "Double tap reset detection for UF2"
	depends on RETENTION_BOOT_MODE
	help
	  Detect a double tap of the reset button to enter UF2
	  mode. Uses the retention boot mode subsystem to detect
	  if the device was reset twice in quick succession.
	  Optionally checks the boot button during the wait period
	  if GPIO entrance is configured.

config MCUBOOT_UF2_DOUBLE_TAP_DELAY
	int "UF2 double tap detection window [ms]"
	default 500
	depends on MCUBOOT_UF2_ENTRANCE_DOUBLE_TAP
	help
	  Time in milliseconds to wait after boot before clearing the
	  retention flag. If the device is reset within this window,
	  it will enter UF2 mode on the next boot.

config MCUBOOT_UF2_NO_APPLICATION
	bool "Enter UF2 mode if no bootable application"
	default y
	help
	  If no valid application is found, enter UF2 mode
	  instead of halting.

endmenu

endif # MCUBOOT_UF2
```

## zephyr-config/west.yml
```yaml
manifest:
  projects:
    - name: zephyr
      url: https://github.com/adafruit/zephyr
      revision: 90cba5dc632d9b4691739e3de304d259dc77eb3f
      clone-depth: 100
      path: zephyr
      import:
        path-prefix: deps
        name-blocklist:
          - mcuboot
```

## zephyr/Kconfig
```kconfig
# Copyright (c) 2026 Adafruit Industries
#
# SPDX-License-Identifier: Apache-2.0

# RP2 boot-mode retention for adaboot_request_update_mode(); see
# boot/zephyr/include/adaboot/update_mode.h.

DT_BOOT_MODE_CHOSEN := zephyr,boot-mode

if SOC_FAMILY_RPI_PICO && $(dt_chosen_enabled,$(DT_BOOT_MODE_CHOSEN))

configdefault RETAINED_MEM
	default y

configdefault RETENTION
	default y

configdefault RETENTION_BOOT_MODE
	default y

endif
```
