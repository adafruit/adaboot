/* Partition layout for stm32h7b3i_dk: the flash memory map shared by the
 * bootloader and every application image. Generated by
 * tools/partition_layout.py; do not edit by hand -- re-run
 * `python3 tools/partition_layout.py --fix stm32h7b3i_dk` after changing
 * the upstream board geometry or tools/boards.toml.
 *
 * Board-specific overlay glue (delete-nodes, device enablement,
 * aliases/chosen) lives in dts/st/stm32h7b3i_dk.dtsi, which includes
 * this file.
 */

&flash0 {
	partitions {

		/* Inherited from the upstream board dts and kept as-is
		 * (not re-emitted here):
		 *   mcuboot (boot_partition): 0x0 + DT_SIZE_K(128)
		 *   image-0 (slot0_partition): 0x20000 + DT_SIZE_K(1888)
		 */

		storage_partition: partition@1f8000 {
			compatible = "zephyr,mapped-partition";
			label = "storage";
			reg = <0x1f8000 DT_SIZE_K(32)>;
		};
	};
};
