## CMakeLists.txt
```
# SPDX-License-Identifier: Apache-2.0
#
# Bootloader updater application.
#
# This is an ordinary Zephyr application that boots from slot0. It embeds a
# fresh mcuboot.bin (built by `make build`) and, on boot, overwrites the
# board's "mcuboot" (boot) partition with it -- a self-update of the
# bootloader. See src/main.c for the runtime logic and ../README.md for usage.
#
# The mcuboot image to embed is supplied via the MCUBOOT_IMAGE_BIN CMake cache
# variable (an absolute path to a mcuboot.bin). The standalone Makefile's
# `updater` target sets this automatically; for a manual build:
#
#   west build -b <board> samples/bootloader-updater -- \
#       -DEXTRA_ZEPHYR_MODULES=$PWD \
#       -DEXTRA_DTC_OVERLAY_FILE=<path-to-board-layout.dtsi> \
#       -DMCUBOOT_IMAGE_BIN=<path-to>/mcuboot.bin

cmake_minimum_required(VERSION 3.20.0)

find_package(Zephyr REQUIRED HINTS $ENV{ZEPHYR_BASE})
project(bootloader_updater)

target_sources(app PRIVATE src/main.c)

# The mcuboot.bin to embed and write to the boot partition. Required.
set(MCUBOOT_IMAGE_BIN "" CACHE FILEPATH
    "Path to the mcuboot.bin to embed and write to the boot partition")
if(NOT MCUBOOT_IMAGE_BIN)
    message(FATAL_ERROR
        "MCUBOOT_IMAGE_BIN is not set. Point it at a mcuboot.bin, e.g. the one "
        "produced by `make build BOARD=<vendor>_<board>` (build-<vendor>_<board>/mcuboot.bin).")
endif()
if(NOT EXISTS "${MCUBOOT_IMAGE_BIN}")
    message(FATAL_ERROR
        "MCUBOOT_IMAGE_BIN does not exist: '${MCUBOOT_IMAGE_BIN}'. "
        "Build the bootloader first with `make build BOARD=<vendor>_<board>`.")
endif()
get_filename_component(MCUBOOT_IMAGE_BIN_ABS "${MCUBOOT_IMAGE_BIN}" ABSOLUTE)
message(STATUS "Bootloader updater: embedding ${MCUBOOT_IMAGE_BIN_ABS}")

# Embed the binary as a C array initializer (mcuboot_image.bin.inc) consumed by
# `static const uint8_t mcuboot_image[] = { #include <mcuboot_image.bin.inc> };`
# in src/main.c. generate_inc_file_for_target re-runs when the .bin changes.
set(gen_dir ${ZEPHYR_BINARY_DIR}/include/generated)
generate_inc_file_for_target(app ${MCUBOOT_IMAGE_BIN_ABS}
                             ${gen_dir}/mcuboot_image.bin.inc)
```

## prj.conf
```kconfig
# SPDX-License-Identifier: Apache-2.0
#
# Bootloader updater application configuration.
#
# This image is chain-loaded by mcuboot, so it is built as a slot0 mcuboot
# image (CONFIG_BOOTLOADER_MCUBOOT). Adaboot bootloaders are built hash-only
# (CONFIG_BOOT_SIGNATURE_TYPE_NONE), so the image is produced *unsigned* (a
# hash TLV, no signature) via imgtool and is still bootable.
#
# The updater is a transient slot0 installer: you flash it to slot0 (serial /
# UF2 / debugger), it runs once to overwrite the bootloader partition, then you
# reflash your real app. It is therefore signed single-app/overwrite-style
# (CONFIG_MCUBOOT_BOOTLOADER_MODE_SINGLE_APP -> imgtool --overwrite-only, no
# swap trailer) regardless of whether the *target app* uses swap. A second,
# swap-style slot1 variant with the pending trailer (imgtool --pad) is
# produced as a post-build step for boards whose layout has a slot1 (see the
# Makefile's `updater` target and tools/updater_sign.py) so the updater can be
# delivered as an OTA into the secondary slot too.

CONFIG_MAIN_STACK_SIZE=4096

# sys_reboot() after the update.
CONFIG_REBOOT=y

# We need flash (read/erase/write) and the flash map to address the boot
# partition by its DTS node label.
CONFIG_FLASH=y
CONFIG_FLASH_MAP=y

# External ``jedec,spi-nor`` (e.g. nrf54l15dk's mx25r64) must have its driver
# compiled or Zephyr's default flash map fails to link. No-op on boards without
# such a node (the symbol's ``depends on DT_HAS_JEDEC_SPI_NOR_ENABLED`` is
# unmet, so the assignment is dropped). Mirrors conf/adaboot.conf.
CONFIG_SPI_NOR=y

# This image is loaded and validated by mcuboot. It is a slot0 image linked
# against zephyr,code-partition (XIP), so force execute-in-place on; the N6
# board defconfig sets CONFIG_XIP=n (its FSBL apps run from RAM, which does not
# apply to this image).
CONFIG_XIP=y

CONFIG_LOG=y
CONFIG_LOG_MODE_MINIMAL=y

# This image is loaded and validated by mcuboot.
CONFIG_BOOTLOADER_MCUBOOT=y

# The updater is a transient slot0 installer (see header comment): always sign
# it single-app/overwrite-style (no swap trailer). The slot1 swap-style variant
# is produced separately as a post-build step, not by changing this mode.
CONFIG_MCUBOOT_BOOTLOADER_MODE_SINGLE_APP=y

# Adaboot uses no signature (hash-only); produce an unsigned mcuboot image
# (no signing key required).
CONFIG_MCUBOOT_GENERATE_UNSIGNED_IMAGE=y

# Run-once: after overwriting the bootloader, request that the next boot stay
# in the bootloader's serial/UF2 recovery mode so the user can reflash their
# real application (adaboot_request_update_mode() from the module's adaboot
# update-mode helpers, which needs the boot-mode retention region here).
# Silently a no-op on boards whose partition layout defines none.
CONFIG_RETAINED_MEM=y
CONFIG_RETENTION=y
CONFIG_RETENTION_BOOT_MODE=y
```

## app.overlay
```dts
/*
 * SPDX-License-Identifier: Apache-2.0
 *
 * Bootloader updater application overlay.
 *
 * The board's partition layout (applied via -DEXTRA_DTC_OVERLAY_FILE by the
 * Makefile, the same dtsi the bootloader uses) defines boot_partition and
 * slot0_partition. This image is a normal application, so it links into the
 * primary application slot (slot0) -- the bootloader's own app.overlay instead
 * points zephyr,code-partition at boot_partition.
 *
 * With CONFIG_BOOTLOADER_MCUBOOT=y Zephyr selects USE_DT_CODE_PARTITION, which
 * makes the image link against zephyr,code-partition.
 */

/ {
	chosen {
		zephyr,code-partition = &slot0_partition;
	};
};
```

## src/main.c
```c
/*
 * Copyright (c) 2026 Adafruit Industries
 *
 * SPDX-License-Identifier: Apache-2.0
 *
 * Bootloader updater application.
 *
 * This is an ordinary slot0 application that the bootloader (mcuboot) writes
 * into the primary slot and then boots. It carries a fresh mcuboot bootloader
 * image embedded at build time and, on boot, overwrites the "mcuboot" (boot)
 * partition with it -- i.e. it self-updates the bootloader.
 *
 * Workflow:
 *   1. Build the bootloader:        make build BOARD=<vendor>_<board>
 *   2. Build this updater:         make updater BOARD=<vendor>_<board>
 *   3. Flash build-<vendor>_<board>-updater/zephyr/zephyr.signed.bin to slot0 (UF2 /
 *      serial recovery / debugger). mcuboot boots it.
 *   4. The updater erases the boot partition, writes the embedded mcuboot
 *      image, verifies it, then reboots.
 *
 * Run-once / not wearing flash:
 *   - Before writing, the boot partition is read back and compared to the
 *     embedded image. If they already match the write (and erase) is skipped,
 *     so re-running the updater is harmless.
 *   - After a successful write, the updater asks the bootloader for its
 *     update mode before rebooting (adaboot_request_update_mode(), which
 *     sets the boot-mode retention flag where CONFIG_RETENTION_BOOT_MODE is
 *     available). The freshly-written bootloader then enters its serial/UF2
 *     recovery mode instead of booting the updater again, so the user can
 *     reflash their real application. On boards with no request mechanism
 *     the call is a no-op and the device reboots normally.
 */

#include <zephyr/kernel.h>
#include <zephyr/device.h>
#include <zephyr/devicetree.h>
#include <zephyr/storage/flash_map.h>
#include <zephyr/sys/reboot.h>
#include <zephyr/logging/log.h>

#include "adaboot/update_mode.h"

#include <errno.h>
#include <string.h>

LOG_MODULE_REGISTER(bootloader_updater, LOG_LEVEL_INF);

/* The new mcuboot bootloader image, embedded at build time by CMake from the
 * mcuboot.bin produced by `make build`. See CMakeLists.txt.
 */
static const uint8_t mcuboot_image[] = {
#include <mcuboot_image.bin.inc>
};

/* The partition to overwrite: the board's "mcuboot" (boot) partition. */
#define BOOT_NODE      DT_NODELABEL(boot_partition)
#define BOOT_PART_SIZE DT_REG_SIZE(BOOT_NODE)

/* The embedded image must fit in the boot partition. */
BUILD_ASSERT(sizeof(mcuboot_image) <= BOOT_PART_SIZE,
             "embedded mcuboot image is larger than the boot partition");

/* Write chunk size. Must be a multiple of the flash write-block alignment so
 * every flash_area_write() (except the final, padded one) is aligned; checked
 * at runtime.
 */
#define CHUNK 4096

static uint8_t buf[CHUNK];

/* Return true if the boot partition already byte-for-byte matches the embedded
 * image (over the image length), so the write can be skipped. */
static bool boot_partition_matches(void)
{
    const struct flash_area *boot = NULL;
    size_t off = 0;
    int rc;

    rc = flash_area_open(PARTITION_ID(boot_partition), &boot);
    if (rc != 0 || boot == NULL) {
        LOG_WRN("could not open boot partition for compare: %d", rc);
        return false;
    }

    while (off < sizeof(mcuboot_image)) {
        size_t cmp = MIN(CHUNK, sizeof(mcuboot_image) - off);

        rc = flash_area_read(boot, off, buf, cmp);
        if (rc != 0) {
            flash_area_close(boot);
            LOG_WRN("read failed at %zu: %d", off, rc);
            return false;
        }
        if (memcmp(buf, mcuboot_image + off, cmp) != 0) {
            flash_area_close(boot);
            return false;
        }
        off += cmp;
    }

    flash_area_close(boot);
    return true;
}

static int overwrite_bootloader(void)
{
    const struct flash_area *boot = NULL;
    uint32_t align;
    uint8_t erased;
    size_t off;
    int rc;

    rc = flash_area_open(PARTITION_ID(boot_partition), &boot);
    if (rc != 0 || boot == NULL) {
        LOG_ERR("could not open boot partition: %d", rc);
        return -EIO;
    }

    if (!flash_area_device_is_ready(boot)) {
        LOG_ERR("boot partition flash device not ready");
        flash_area_close(boot);
        return -ENODEV;
    }

    align = flash_area_align(boot);
    if (align == 0) {
        align = 1;
    }
    if (align > CHUNK || (CHUNK % align) != 0) {
        LOG_ERR("write alignment %u unsupported (chunk %u)", align, CHUNK);
        flash_area_close(boot);
        return -EINVAL;
    }
    erased = flash_area_erased_val(boot);

    LOG_INF("erasing boot partition (%u bytes)", (unsigned)BOOT_PART_SIZE);
    rc = flash_area_erase(boot, 0, BOOT_PART_SIZE);
    if (rc != 0) {
        LOG_ERR("erase failed: %d", rc);
        flash_area_close(boot);
        return rc;
    }

    LOG_INF("writing %zu bytes", sizeof(mcuboot_image));
    off = 0;
    while (off < sizeof(mcuboot_image)) {
        size_t remain = sizeof(mcuboot_image) - off;
        size_t copy = MIN(CHUNK, remain);
        size_t wr = copy;

        memcpy(buf, mcuboot_image + off, copy);

        /* Pad the final (short) chunk up to the write-block alignment using
         * the erase value so the last flash_area_write() is aligned. The
         * partition beyond the image is already erased to this value, so the
         * padding does not change trailing bytes.
         */
        if (wr % align != 0) {
            size_t pad = align - (wr % align);
            memset(buf + wr, erased, pad);
            wr += pad;
            if (off + wr > BOOT_PART_SIZE) {
                wr = BOOT_PART_SIZE - off;
            }
        }

        rc = flash_area_write(boot, off, buf, wr);
        if (rc != 0) {
            LOG_ERR("write failed at %zu: %d", off, rc);
            flash_area_close(boot);
            return rc;
        }
        off += wr;
    }

    LOG_INF("verifying");
    off = 0;
    while (off < sizeof(mcuboot_image)) {
        size_t cmp = MIN(CHUNK, sizeof(mcuboot_image) - off);

        rc = flash_area_read(boot, off, buf, cmp);
        if (rc != 0) {
            LOG_ERR("verify read failed at %zu: %d", off, rc);
            flash_area_close(boot);
            return rc;
        }
        if (memcmp(buf, mcuboot_image + off, cmp) != 0) {
            LOG_ERR("verify mismatch at offset %zu", off);
            flash_area_close(boot);
            return -EIO;
        }
        off += cmp;
    }

    flash_area_close(boot);
    return 0;
}

int main(void)
{
    int rc;

    LOG_INF("Adaboot bootloader updater");
    LOG_INF("embedded mcuboot image: %zu bytes", sizeof(mcuboot_image));
    LOG_INF("boot partition: %u bytes", (unsigned)BOOT_PART_SIZE);

    if (boot_partition_matches()) {
        LOG_INF("boot partition already matches the embedded image; nothing to do");
    } else {
        rc = overwrite_bootloader();
        if (rc != 0) {
            LOG_ERR("bootloader update FAILED (%d); not rebooting", rc);
            return 0;
        }
        LOG_INF("bootloader updated successfully");
    }

    /* Ask the freshly written bootloader for its update mode, so the next
     * boot waits for new firmware instead of running this updater again.
     * A no-op on boards with no request mechanism.
     */
    adaboot_request_update_mode(true);

    LOG_INF("rebooting");
    sys_reboot(SYS_REBOOT_COLD);

    return 0;
}
```
