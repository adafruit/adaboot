## zephyr-config/west.yml
```yaml
manifest:
  projects:
    - name: zephyr
      url: https://github.com/adafruit/zephyr
      revision: 87f27e4e1ce528367de5936cd4ee9fa4c32d42a8
      clone-depth: 100
      path: zephyr
      import:
        path-prefix: deps
        name-blocklist:
          - mcuboot
```
